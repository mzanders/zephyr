## boards/arm/waveshare_4.3inch_epaper/Kconfig.board
```kconfig
# Waveshare Open103Z board configuration

# Copyright (c) 2020 Stefano Manni
# SPDX-License-Identifier: Apache-2.0

config BOARD_WAVESHARE_4.3INCH_EPAPER
	bool "Waveshare 4.3inch ePaper module"
	depends on SOC_STM32F103XE
```

## boards/arm/waveshare_4.3inch_epaper/Kconfig.defconfig
```kconfig
# Waveshare Open103Z board configuration

# Copyright (c) 2020 Stefano Manni
# SPDX-License-Identifier: Apache-2.0

if BOARD_WAVESHARE_4.3INCH_EPAPER

config BOARD
	default "waveshare_4.3inch_epaper"

endif # BOARD_WAVESHARE_4.3INCH_EPAPER
```
